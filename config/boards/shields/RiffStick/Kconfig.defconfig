## config/boards/shields/RiffStick/Kconfig.defconfig
```kconfig
if SHIELD_RIFFSTICK

config ZMK_KEYBOARD_NAME
    default "RiffStick"

CONFIG_BT=y
CONFIG_BT_PERIPHERAL=y
CONFIG_BT_HIDS=y
CONFIG_BT_DEVICE_NAME="MyMacroPad"
CONFIG_ZMK_BLE=y
CONFIG_ZMK_BLE_PERIPHERAL=y
CONFIG_ZMK_BLE_PROFILE_COUNT=5

endif
```
