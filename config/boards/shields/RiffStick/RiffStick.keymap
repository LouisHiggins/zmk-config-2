#include <behaviors.dtsi>
#include <dt-bindings/zmk/keys.h>
#include <dt-bindings/zmk/bt.h>

/ {
    keymap {
        compatible = "zmk,keymap";

        default_layer {
            bindings = <
                &kp Q
                &kp W
                &kp E
                &kp A
                &kp S
                &kp D
                &kp Z
                &kp X
		&kp B
                &mo 1
            >;
        };

        bt_layer {
	    bindings = <
                &none
		&none
                &none
                &bootloader
                &none
                &bt BT_CLR_ALL
                &bt BT_CLR
                &bt BT_SEL 0
                &bt BT_SEL 1
                &bt BT_SEL 2
            >;
        };
    };
};